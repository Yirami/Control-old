/*使用I/O资源：P1.0,P1.1,P1.2,P3.2,P3.3*/
/************************
地址初始化
************************/
PWM IDATA 80H 			//位于扩展内部RAM，只能间接寻址
IPH DATA 0B7H 			//定义特殊功能寄存器IPH(用作4级优先级设置)
ORG 0000H     			//复位地址
AJMP MAIN     			//绝对短跳转至主程序
ORG 0003H	  			//外中断0入口地址
AJMP KEY0     			//绝对跳转至外中断0子程序
ORG 000BH     			//定时器0入口地址
AJMP TIME0    			//绝对跳转至定时器0子程序
ORG 0013H     			//外中断1入口地址
AJMP KEY1     			//绝对跳转至外中断1子程序
ORG 001BH     			//定时器1入口地址
AJMP TIME1    			//绝对跳转至定时器1子程序
ORG 0100H     			//主程序地址分配
/************************
主程序
************************/
MAIN:	   	  
CALL CHUSHI0  			//调用初始化子程序，进行中断优先级设置，定时器模式设置，初始化定时器0
CALL CHUSHI1  			//调用初始化子程序，初始化定时器1
sjmp $
/************************
数据初始化
************************/
CHUSHI0:
MOV R1,#80H				
MOV @R1,#00H			//PWM中装入初值00H,读入表第一组数据
MOV TMOD,#00010001B		//定时器0和定时器1都为模式1（16位）
MOV IE,#10001111B		//开启总中断；外部中断0，1；定时器中断0，1
MOV IP,#00000010B		
MOV IPH,#00001010B		//设置定时器0，1为最高级3级优先，外部中断0，1为最低级0级优先
MOV TH0,#0D8H			//装入定时器0高八位初值
MOV TL0,#0EFH			//装入定时器0低八位初值
RET
CHUSHI1:
MOV R1,#PWM				
MOV A,@R1
MOV DPTR,#PWMH		    //表格首地址装入16位数据指针
MOVC A,@A+DPTR			//读取表格数据至累加器
MOV TH1,A				//累加器数据装入定时器1高八位
MOV A,@R1
MOV DPTR,#PWML			//表格首地址装入16位数据指针
MOVC A,@A+DPTR			//读取表格数据至累加器
MOV TL1,A				//累加器数据装入定时器1低八位
RET
/************************
0号按键判断(加速)
************************/
KEY0:	                //按键0外部中断子程序
CALL DELAY	            //软件去抖，调用延时子程序，延时大约10ms
JNB P3.2,KEY01		    //判断P3.2低电平跳转（确实按下）
RETI
KEY01:
CALL DELAY				//松手去抖，调用延时子程序，延时大约10ms
JB P3.2,KEY02			//判断P3.2高电平跳转（确实松手）
JNB P3.2,KEY01		    //判断P3.2低电平跳转（循环检测松手高电平）  
KEY02:
MOV R1,#PWM
CJNE @R1,#0BH,KEY03		//比较是否要全负荷工作，不是就跳转
CLR TR0					//关闭定时器0
CLR TR1					//关闭定时器1
CLR P1.0				//置零P1.0，电机保持工作
CLR P1.1				//全负荷灯亮
RETI
KEY03:
MOV R1,#PWM				
INC @R1					//表格组数加一，读取下一个控制脉冲宽度数据
SETB P1.2				//低速灯关
SETB TR0				//开启定时器0
RETI
/************************
1号按键判断(减速)
************************/
KEY1:	               	//按键1外部中断子程序
CALL DELAY	            //软件去抖，调用延时子程序，延时大约10ms
JNB P3.3,KEY11			//判断P3.3低电平跳转（确实按下）
RETI
KEY11:
CALL DELAY				//松手去抖，调用延时子程序，延时大约10ms
JB P3.3,KEY12			//判断P3.3高电平跳转（确实松手）
JNB P3.3,KEY11			//判断P3.3低电平跳转（循环检测松手高电平）
KEY12:
MOV R1,#PWM
CJNE @R1,#00H,KEY13		//比较是否要停止工作，不是就跳转
CLR TR0				    //关闭定时器0
CLR TR1			    	//关闭定时器1
SETB P1.0				//关闭电机
SETB P1.2				//关闭低速灯
RETI 
KEY13:
SETB P1.1				//关闭全负荷灯
SETB TR0				//开启定时器0
MOV R1,#PWM				//PWM表格组数送入寄存器
DEC @R1					//表格组数减一，读取上一个控制脉冲宽度数据
CJNE @R1,#00H,KEY14		//判断是否为低速运转，不是就跳转
CLR P1.2				//开启低速灯
RETI
KEY14:
RETI
/************************
定时器0工作控制
************************/
TIME0:	      			//定时器0中断子程序
CLR P1.0      			//置零P1.0,电机工作
CLR TR0
MOV TH0,#0D8H  			//重装定时器0高8位
MOV TL0,#0EFH  			//重装定时器0低8位
SETB TR0
SETB TR1 	  			//置位TR1,定时器1开始计时
RETI		  			//中断子程序返回
/************************
定时器1工作控制
************************/
TIME1:	      			//定时器1子程序
SETB P1.0     			//置位P1.0，电机停止工作
CLR TR1		  			//置零TR1，定时器1停止工作
CALL CHUSHI1  			//调用初始化程序，初始化定时器1
RETI		  			//中断子程序返回
/*************************
延时子程序
*************************/
DELAY:		  
MOV R7, #0AH  			//10轮回，耗时10*2*2*256机器周期，12M晶振约为10ms
LOOP:
MOV R6, #0B	  
DJNZ R6, $	  			//2^8减一判零，256条双字节指令，耗时2*256机器周期
DJNZ R6, $	  			//2^8减一判零，256条双字节指令，耗时2*256机器周期
DJNZ R7, LOOP 			//10减一判零
RET
/*************************
数据表
*************************/
PWMH:
DB 0F0H,0EEH,0ECH,0EAH,0E8H,0E6H,0E4H,0E2H,0E0H,0DEH,0DCH,0DAH
PWML:
DB 5FH,6BH,77H,83H,8FH,9BH,0A7H,0B3H,0BFH,0CBH,0D7H,0E3H
END